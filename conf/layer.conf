## conf/layer.conf
```bitbake
# We have a conf and classes directory, add to BBPATH
BBPATH .= ":${LAYERDIR}"

# We have a packages directory, add to BBFILES
BBFILES += "${LAYERDIR}/recipes-*/*/*.bb \
            ${LAYERDIR}/recipes-*/*/*.bbappend"

BBFILE_PRIORITY_accordance-nxp = "10"

BBFILE_COLLECTIONS += "accordance-nxp"
BBFILE_PATTERN_accordance-nxp := "^${LAYERDIR}"

LAYERSERIES_COMPAT_accordance-nxp = "scarthgap"
```
